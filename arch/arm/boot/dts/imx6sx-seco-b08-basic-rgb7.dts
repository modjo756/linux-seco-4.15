/*
* Author: Giuseppe Pagano <giuseppe.pagano@seco.com>
*
* This program is free software; you can redistribute it and/or modify
* it under the terms of the GNU General Public License version 2 as
* published by the Free Software Foundation.
*
*
*/

/dts-v1/;

#include "imx6sx-seco-b08-rgb7.dtsi" 

/ {
        model = "SECO B08 BASIC (based on iMX.6 SoloX) RGB 7'' Display";
        compatible = "fsl,imx6sx-seco-b08", "fsl,imx6sx-sdb", "fsl,imx6sx";
};

&fec2 {
	status = "disabled";
};
